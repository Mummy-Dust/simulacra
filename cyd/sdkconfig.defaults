## cyd/sdkconfig.defaults
```kconfig
CONFIG_ESPTOOLPY_FLASHSIZE_4MB=y
CONFIG_PARTITION_TABLE_SINGLE_APP_LARGE=y
# Long filenames on the SD card (path /sdcard/simulacra/learn.db needs >8.3 names)
CONFIG_FATFS_LFN_STACK=y
CONFIG_FATFS_MAX_LFN=255
# The main task runs the touch/render loop AND signs CONFIG frames inline; TweetNaCl
# Ed25519 signing needs several KB of stack, well over the 3584 default -> overflow reboot.
CONFIG_ESP_MAIN_TASK_STACK_SIZE=12288
```

## sdkconfig.defaults
```kconfig
# Target: ESP32-WROVER-E (classic ESP32, dual-core, PSRAM).
# The target is selected with `idf.py set-target esp32` rather than pinned here,
# which is the canonical approach and avoids IDF_TARGET-mismatch build errors.

# Bluetooth: enable controller + NimBLE host (lighter than Bluedroid, ideal for
# a broadcaster-only workload). Bluedroid stays off.
CONFIG_BT_ENABLED=y
CONFIG_BT_NIMBLE_ENABLED=y

# simulacra only broadcasts (non-connectable advertising). We'd prefer broadcaster-
# only, but ESP-IDF v5.4's ble_gap.c references ble_gap_call_conn_event_cb() in
# ble_gap_set_data_len() unconditionally while that helper is compiled out unless a
# connect role is enabled -> -Werror implicit-declaration. So we keep the PERIPHERAL
# role on (it defines NIMBLE_BLE_CONNECT) to compile cleanly; we never accept a
# connection. CENTRAL and OBSERVER (scanning) stay off.
CONFIG_BT_NIMBLE_ROLE_BROADCASTER=y
CONFIG_BT_NIMBLE_ROLE_PERIPHERAL=y
CONFIG_BT_NIMBLE_ROLE_CENTRAL=n
CONFIG_BT_NIMBLE_ROLE_OBSERVER=n

# Slightly larger app log buffer is handy while we tune on hardware.
CONFIG_LOG_DEFAULT_LEVEL_INFO=y
```

## sdkconfig.defaults.esp32c5
```kconfig
# ESP32-C5 (Bluetooth 5.0) overrides — merged on top of sdkconfig.defaults when
# the target is esp32c5.
#
# Enable extended advertising with the maximum number of concurrent advertising
# instances, so simulacra can run several genuinely-simultaneous decoys (each its
# own MAC), instead of the one-at-a-time legacy advertiser on the classic ESP32.
# The instances are configured as LEGACY PDUs in firmware (see simulacra_main.c)
# so ordinary/legacy scanners still see them.
CONFIG_BT_NIMBLE_EXT_ADV=y
CONFIG_BT_NIMBLE_MAX_EXT_ADV_INSTANCES=4

# Observe mode (M5 / the Ward persona): enable the NimBLE observer (scanning) role so
# ble_gap_ext_disc() can passively profile the ambient environment. The C6 hit this exact
# gap during M5 — without it, scanning silently returns no reports.
CONFIG_BT_NIMBLE_ROLE_OBSERVER=y

# Console on UART0: we flash/monitor through the DevKit's UART bridge port
# (a CH343 USB-serial chip), which — unlike the native USB-Serial-JTAG — does not
# re-enumerate when the chip resets, so flashing and logging are reliable (esp. in
# a VM). The bridge's RTS/DTR drive EN/GPIO9 for auto-reset.
CONFIG_ESP_CONSOLE_UART_DEFAULT=y

# M8: software coexistence so the Wi-Fi and BT controllers run concurrently and
# esp_coex arbitrates radio access. Our Wi-Fi use is injection-only (no AP association).
CONFIG_ESP_COEX_SW_COEXIST_ENABLE=y
```

## sdkconfig.defaults.esp32c6
```kconfig
# Splinter v2: extended advertising for genuinely-concurrent decoy instances on the C6.
# With NimBLE as the host, the controller's BT_LE_* ext-adv symbols are inactive
# (they depend on !BT_NIMBLE_ENABLED). The controller derives its concurrent
# instance count from the NimBLE host value below (verified: 4 instances run).
CONFIG_BT_NIMBLE_EXT_ADV=y
CONFIG_BT_NIMBLE_MAX_EXT_ADV_INSTANCES=4

# M5 observe mode: enable the NimBLE observer (scanning) role so ble_gap_disc() can
# passively scan the ambient BLE environment. The default decoy build is broadcaster-only
# and never scans; enabling observer here is inert for it (just links scan support in).
CONFIG_BT_NIMBLE_ROLE_OBSERVER=y

# M8: software coexistence so the Wi-Fi and BT controllers run concurrently and
# esp_coex arbitrates radio access. Our Wi-Fi use is injection-only (no AP association).
CONFIG_ESP_COEX_SW_COEXIST_ENABLE=y

# M8: BLE + Wi-Fi together (~1.2 MB binary) exceeds the default 1 MB factory partition.
# Switch to the 1500 K "large" single-app layout, which still fits in 2 MB flash.
CONFIG_PARTITION_TABLE_SINGLE_APP_LARGE=y
```

## sdkconfig.defaults.esp32s3
```kconfig
# Splinter v2: extended advertising on the ESP32-S3 (Adafruit QT Py S3 / Feather S3).
# The firmware is portable across NimBLE targets; only the per-target ext-adv
# concurrency knob lives here. The shared sdkconfig.defaults carries the common
# BT/NimBLE host + role config. Verified: builds clean for esp32s3.
CONFIG_BT_NIMBLE_EXT_ADV=y
CONFIG_BT_NIMBLE_MAX_EXT_ADV_INSTANCES=4

# PSRAM is intentionally left OFF so this image boots on BOTH QT Py S3 variants:
#   - No-PSRAM   (Adafruit PID 5426, 8MB flash)
#   - 2MB PSRAM  (Adafruit PID 5700, 4MB flash) and the Feather S3 (PID 5477)
# When you've confirmed a PSRAM board and want the M5/M6 buffering headroom, add:
#   CONFIG_SPIRAM=y
# (Adafruit S3 boards use quad PSRAM, which is the IDF default SPIRAM mode.)
```
